## examples/board-led/main/Kconfig.projbuild
```kconfig
menu "ESPKit board LED"

    config ESPKIT_BOARD_LED_GPIO
        int "Onboard WS2812 GPIO"
        default 48
        range 0 48
        help
            Data pin for the onboard WS2812 RGB LED. GPIO 48 is the usual pin
            on ESP32-S3-WROOM CAM / Freenove-style boards and on Espressif's
            official ESP32-S3 DevKits.

    config ESPKIT_BOARD_LED_COUNT
        int "WS2812 LED count"
        default 1
        range 1 16
        help
            Number of WS2812 LEDs on the strip. The onboard LED is one pixel.

endmenu
```

## examples/board-led/sdkconfig.defaults
```kconfig
CONFIG_COMPILER_CXX_EXCEPTIONS=n
CONFIG_COMPILER_CXX_RTTI=n
CONFIG_ESPTOOLPY_FLASHSIZE_16MB=y
```

## examples/camera-stream/main/Kconfig.projbuild
```kconfig
menu "ESPKit camera stream"

    choice ESPKIT_CAMERA_STREAM_PIN_PRESET
        prompt "Camera pin map preset"
        default ESPKIT_CAMERA_STREAM_PRESET_ESP32S3_EYE
        help
            The ESP32-S3-EYE map is also used by common ESP32-S3-WROOM CAM /
            Freenove-style boards. Choose Custom and edit the GPIO values
            below if your module is wired differently.

        config ESPKIT_CAMERA_STREAM_PRESET_ESP32S3_EYE
            bool "ESP32-S3-EYE / common WROOM CAM"
        config ESPKIT_CAMERA_STREAM_PRESET_CUSTOM
            bool "Custom pin map"
    endchoice

    config ESPKIT_CAMERA_STREAM_PIN_PWDN
        int "PWDN GPIO (-1 if unused)"
        depends on ESPKIT_CAMERA_STREAM_PRESET_CUSTOM
        default -1
        range -1 48
    config ESPKIT_CAMERA_STREAM_PIN_RESET
        int "RESET GPIO (-1 if unused)"
        depends on ESPKIT_CAMERA_STREAM_PRESET_CUSTOM
        default -1
        range -1 48
    config ESPKIT_CAMERA_STREAM_PIN_XCLK
        int "XCLK GPIO"
        depends on ESPKIT_CAMERA_STREAM_PRESET_CUSTOM
        default 15
        range 0 48
    config ESPKIT_CAMERA_STREAM_PIN_SIOD
        int "SCCB SDA (SIOD) GPIO"
        depends on ESPKIT_CAMERA_STREAM_PRESET_CUSTOM
        default 4
        range 0 48
    config ESPKIT_CAMERA_STREAM_PIN_SIOC
        int "SCCB SCL (SIOC) GPIO"
        depends on ESPKIT_CAMERA_STREAM_PRESET_CUSTOM
        default 5
        range 0 48
    config ESPKIT_CAMERA_STREAM_PIN_D0
        int "Y2 / D0 GPIO"
        depends on ESPKIT_CAMERA_STREAM_PRESET_CUSTOM
        default 11
        range 0 48
    config ESPKIT_CAMERA_STREAM_PIN_D1
        int "Y3 / D1 GPIO"
        depends on ESPKIT_CAMERA_STREAM_PRESET_CUSTOM
        default 9
        range 0 48
    config ESPKIT_CAMERA_STREAM_PIN_D2
        int "Y4 / D2 GPIO"
        depends on ESPKIT_CAMERA_STREAM_PRESET_CUSTOM
        default 8
        range 0 48
    config ESPKIT_CAMERA_STREAM_PIN_D3
        int "Y5 / D3 GPIO"
        depends on ESPKIT_CAMERA_STREAM_PRESET_CUSTOM
        default 10
        range 0 48
    config ESPKIT_CAMERA_STREAM_PIN_D4
        int "Y6 / D4 GPIO"
        depends on ESPKIT_CAMERA_STREAM_PRESET_CUSTOM
        default 12
        range 0 48
    config ESPKIT_CAMERA_STREAM_PIN_D5
        int "Y7 / D5 GPIO"
        depends on ESPKIT_CAMERA_STREAM_PRESET_CUSTOM
        default 18
        range 0 48
    config ESPKIT_CAMERA_STREAM_PIN_D6
        int "Y8 / D6 GPIO"
        depends on ESPKIT_CAMERA_STREAM_PRESET_CUSTOM
        default 17
        range 0 48
    config ESPKIT_CAMERA_STREAM_PIN_D7
        int "Y9 / D7 GPIO"
        depends on ESPKIT_CAMERA_STREAM_PRESET_CUSTOM
        default 16
        range 0 48
    config ESPKIT_CAMERA_STREAM_PIN_VSYNC
        int "VSYNC GPIO"
        depends on ESPKIT_CAMERA_STREAM_PRESET_CUSTOM
        default 6
        range 0 48
    config ESPKIT_CAMERA_STREAM_PIN_HREF
        int "HREF GPIO"
        depends on ESPKIT_CAMERA_STREAM_PRESET_CUSTOM
        default 7
        range 0 48
    config ESPKIT_CAMERA_STREAM_PIN_PCLK
        int "PCLK GPIO"
        depends on ESPKIT_CAMERA_STREAM_PRESET_CUSTOM
        default 13
        range 0 48

    choice ESPKIT_CAMERA_STREAM_FRAME_SIZE
        prompt "JPEG frame size"
        default ESPKIT_CAMERA_STREAM_FRAMESIZE_VGA
        help
            VGA is the usual preview size on this board. Expect about 5-6
            frames per second over HTTP. QVGA is smoother.

        config ESPKIT_CAMERA_STREAM_FRAMESIZE_QVGA
            bool "QVGA (320x240)"
        config ESPKIT_CAMERA_STREAM_FRAMESIZE_VGA
            bool "VGA (640x480)"
    endchoice

    config ESPKIT_CAMERA_STREAM_JPEG_QUALITY
        int "JPEG quality (lower is better, 4-20)"
        default 12
        range 4 20

    config ESPKIT_CAMERA_STREAM_SSID
        string "Wi-Fi SSID"
        default ""
        help
            Leave empty in the committed defaults. Put the SSID in an untracked
            sdkconfig.defaults.local or sdkconfig.local, or provision it into
            the espkit NVS namespace.

    config ESPKIT_CAMERA_STREAM_PASSWORD
        string "Wi-Fi password"
        default ""
        help
            WPA2-PSK password. Never commit this value. It is not logged.

endmenu
```

## examples/camera-timelapse/main/Kconfig.projbuild
```kconfig
menu "ESPKit camera timelapse"

    choice ESPKIT_CAMERA_TIMELAPSE_PIN_PRESET
        prompt "Camera pin map preset"
        default ESPKIT_CAMERA_TIMELAPSE_PRESET_ESP32S3_EYE
        help
            The ESP32-S3-EYE map is also used by common ESP32-S3-WROOM CAM /
            Freenove-style boards. Choose Custom and edit the GPIO values
            below if your module is wired differently.

        config ESPKIT_CAMERA_TIMELAPSE_PRESET_ESP32S3_EYE
            bool "ESP32-S3-EYE / common WROOM CAM"
        config ESPKIT_CAMERA_TIMELAPSE_PRESET_CUSTOM
            bool "Custom pin map"
    endchoice

    config ESPKIT_CAMERA_TIMELAPSE_PIN_PWDN
        int "PWDN GPIO (-1 if unused)"
        depends on ESPKIT_CAMERA_TIMELAPSE_PRESET_CUSTOM
        default -1
        range -1 48
    config ESPKIT_CAMERA_TIMELAPSE_PIN_RESET
        int "RESET GPIO (-1 if unused)"
        depends on ESPKIT_CAMERA_TIMELAPSE_PRESET_CUSTOM
        default -1
        range -1 48
    config ESPKIT_CAMERA_TIMELAPSE_PIN_XCLK
        int "XCLK GPIO"
        depends on ESPKIT_CAMERA_TIMELAPSE_PRESET_CUSTOM
        default 15
        range 0 48
    config ESPKIT_CAMERA_TIMELAPSE_PIN_SIOD
        int "SCCB SDA (SIOD) GPIO"
        depends on ESPKIT_CAMERA_TIMELAPSE_PRESET_CUSTOM
        default 4
        range 0 48
    config ESPKIT_CAMERA_TIMELAPSE_PIN_SIOC
        int "SCCB SCL (SIOC) GPIO"
        depends on ESPKIT_CAMERA_TIMELAPSE_PRESET_CUSTOM
        default 5
        range 0 48
    config ESPKIT_CAMERA_TIMELAPSE_PIN_D0
        int "Y2 / D0 GPIO"
        depends on ESPKIT_CAMERA_TIMELAPSE_PRESET_CUSTOM
        default 11
        range 0 48
    config ESPKIT_CAMERA_TIMELAPSE_PIN_D1
        int "Y3 / D1 GPIO"
        depends on ESPKIT_CAMERA_TIMELAPSE_PRESET_CUSTOM
        default 9
        range 0 48
    config ESPKIT_CAMERA_TIMELAPSE_PIN_D2
        int "Y4 / D2 GPIO"
        depends on ESPKIT_CAMERA_TIMELAPSE_PRESET_CUSTOM
        default 8
        range 0 48
    config ESPKIT_CAMERA_TIMELAPSE_PIN_D3
        int "Y5 / D3 GPIO"
        depends on ESPKIT_CAMERA_TIMELAPSE_PRESET_CUSTOM
        default 10
        range 0 48
    config ESPKIT_CAMERA_TIMELAPSE_PIN_D4
        int "Y6 / D4 GPIO"
        depends on ESPKIT_CAMERA_TIMELAPSE_PRESET_CUSTOM
        default 12
        range 0 48
    config ESPKIT_CAMERA_TIMELAPSE_PIN_D5
        int "Y7 / D5 GPIO"
        depends on ESPKIT_CAMERA_TIMELAPSE_PRESET_CUSTOM
        default 18
        range 0 48
    config ESPKIT_CAMERA_TIMELAPSE_PIN_D6
        int "Y8 / D6 GPIO"
        depends on ESPKIT_CAMERA_TIMELAPSE_PRESET_CUSTOM
        default 17
        range 0 48
    config ESPKIT_CAMERA_TIMELAPSE_PIN_D7
        int "Y9 / D7 GPIO"
        depends on ESPKIT_CAMERA_TIMELAPSE_PRESET_CUSTOM
        default 16
        range 0 48
    config ESPKIT_CAMERA_TIMELAPSE_PIN_VSYNC
        int "VSYNC GPIO"
        depends on ESPKIT_CAMERA_TIMELAPSE_PRESET_CUSTOM
        default 6
        range 0 48
    config ESPKIT_CAMERA_TIMELAPSE_PIN_HREF
        int "HREF GPIO"
        depends on ESPKIT_CAMERA_TIMELAPSE_PRESET_CUSTOM
        default 7
        range 0 48
    config ESPKIT_CAMERA_TIMELAPSE_PIN_PCLK
        int "PCLK GPIO"
        depends on ESPKIT_CAMERA_TIMELAPSE_PRESET_CUSTOM
        default 13
        range 0 48

    choice ESPKIT_CAMERA_TIMELAPSE_FRAME_SIZE
        prompt "JPEG frame size"
        default ESPKIT_CAMERA_TIMELAPSE_FRAMESIZE_VGA
        help
            VGA is the usual still size on this board.

        config ESPKIT_CAMERA_TIMELAPSE_FRAMESIZE_QVGA
            bool "QVGA (320x240)"
        config ESPKIT_CAMERA_TIMELAPSE_FRAMESIZE_VGA
            bool "VGA (640x480)"
    endchoice

    config ESPKIT_CAMERA_TIMELAPSE_JPEG_QUALITY
        int "JPEG quality (lower is better, 4-20)"
        default 12
        range 4 20

    choice ESPKIT_CAMERA_TIMELAPSE_DEFAULT_MODE
        prompt "Default capture mode"
        default ESPKIT_CAMERA_TIMELAPSE_MODE_TIMELAPSE
        help
            The HTTP settings page can switch this at runtime.

        config ESPKIT_CAMERA_TIMELAPSE_MODE_TIMELAPSE
            bool "Timelapse (period capture)"
        config ESPKIT_CAMERA_TIMELAPSE_MODE_MOTION
            bool "Motion (store a still when the score crosses the threshold)"
    endchoice

    config ESPKIT_CAMERA_TIMELAPSE_INTERVAL_S
        int "Timelapse interval (seconds)"
        default 10
        range 1 3600

    config ESPKIT_CAMERA_TIMELAPSE_MOTION_PERIOD_MS
        int "Motion sample period (milliseconds)"
        default 500
        range 100 5000

    config ESPKIT_CAMERA_TIMELAPSE_PIXEL_THRESHOLD
        int "Motion pixel difference threshold"
        default 24
        range 1 64
        help
            Absolute grayscale difference after optional brightness
            compensation. Differences below this are treated as noise.

    config ESPKIT_CAMERA_TIMELAPSE_CHANGED_PERMILLE
        int "Motion changed-pixel threshold (per thousand)"
        default 40
        range 1 500
        help
            40 means 4% of downscaled pixels must change to count as motion.

    config ESPKIT_CAMERA_TIMELAPSE_COOLDOWN_MS
        int "Motion cooldown (milliseconds)"
        default 5000
        range 0 60000

    config ESPKIT_CAMERA_TIMELAPSE_RING_SLOTS
        int "PSRAM ring buffer slots"
        default 24
        range 4 32
        help
            Oldest stills are overwritten when the ring is full. There is no
            SD card path in this example; stills are lost on reboot.

    config ESPKIT_CAMERA_TIMELAPSE_LED_GPIO
        int "Onboard WS2812 GPIO"
        default 48
        range 0 48

    config ESPKIT_CAMERA_TIMELAPSE_LED_COUNT
        int "WS2812 LED count"
        default 1
        range 1 16

    config ESPKIT_CAMERA_TIMELAPSE_SSID
        string "Wi-Fi SSID"
        default ""
        help
            Leave empty in the committed defaults. Put the SSID in an untracked
            sdkconfig.defaults.local or sdkconfig.local, or provision it into
            the espkit NVS namespace.

    config ESPKIT_CAMERA_TIMELAPSE_PASSWORD
        string "Wi-Fi password"
        default ""
        help
            WPA2-PSK password. Never commit this value. It is not logged.

    config ESPKIT_CAMERA_TIMELAPSE_REFUSE_GRACE_S
        int "Seconds to keep a refused OTA image reachable before rollback"
        default 8
        range 0 30

endmenu
```

## examples/camera-timelapse/sdkconfig.defaults
```kconfig
CONFIG_COMPILER_CXX_EXCEPTIONS=n
CONFIG_COMPILER_CXX_RTTI=n
CONFIG_ESPTOOLPY_FLASHSIZE_16MB=y
CONFIG_ESPTOOLPY_FLASHFREQ_80M=y
CONFIG_ESP_DEFAULT_CPU_FREQ_MHZ_240=y
# ESP32-S3R8 (N16R8) has 8 MB of embedded octal PSRAM.
CONFIG_SPIRAM=y
CONFIG_SPIRAM_MODE_OCT=y
CONFIG_SPIRAM_SPEED_80M=y
CONFIG_ESPKIT_NETWORK_ENABLED=y
CONFIG_PARTITION_TABLE_CUSTOM=y
CONFIG_PARTITION_TABLE_CUSTOM_FILENAME="../../partitions.csv"
CONFIG_BOOTLOADER_APP_ROLLBACK_ENABLE=y
CONFIG_ESP_CONSOLE_UART_DEFAULT=y
CONFIG_ESP_CONSOLE_SECONDARY_USB_SERIAL_JTAG=y
CONFIG_ESP_MAIN_TASK_STACK_SIZE=8192
```

## examples/camera/main/Kconfig.projbuild
```kconfig
menu "ESPKit board camera"

    choice ESPKIT_CAMERA_PIN_PRESET
        prompt "Camera pin map preset"
        default ESPKIT_CAMERA_PRESET_ESP32S3_EYE
        help
            The ESP32-S3-EYE map is also used by common ESP32-S3-WROOM CAM /
            Freenove-style boards. Choose Custom and edit the GPIO values
            below if your module is wired differently.

        config ESPKIT_CAMERA_PRESET_ESP32S3_EYE
            bool "ESP32-S3-EYE / common WROOM CAM"
        config ESPKIT_CAMERA_PRESET_CUSTOM
            bool "Custom pin map"
    endchoice

    config ESPKIT_CAMERA_PIN_PWDN
        int "PWDN GPIO (-1 if unused)"
        depends on ESPKIT_CAMERA_PRESET_CUSTOM
        default -1
        range -1 48
    config ESPKIT_CAMERA_PIN_RESET
        int "RESET GPIO (-1 if unused)"
        depends on ESPKIT_CAMERA_PRESET_CUSTOM
        default -1
        range -1 48
    config ESPKIT_CAMERA_PIN_XCLK
        int "XCLK GPIO"
        depends on ESPKIT_CAMERA_PRESET_CUSTOM
        default 15
        range 0 48
    config ESPKIT_CAMERA_PIN_SIOD
        int "SCCB SDA (SIOD) GPIO"
        depends on ESPKIT_CAMERA_PRESET_CUSTOM
        default 4
        range 0 48
    config ESPKIT_CAMERA_PIN_SIOC
        int "SCCB SCL (SIOC) GPIO"
        depends on ESPKIT_CAMERA_PRESET_CUSTOM
        default 5
        range 0 48
    config ESPKIT_CAMERA_PIN_D0
        int "Y2 / D0 GPIO"
        depends on ESPKIT_CAMERA_PRESET_CUSTOM
        default 11
        range 0 48
    config ESPKIT_CAMERA_PIN_D1
        int "Y3 / D1 GPIO"
        depends on ESPKIT_CAMERA_PRESET_CUSTOM
        default 9
        range 0 48
    config ESPKIT_CAMERA_PIN_D2
        int "Y4 / D2 GPIO"
        depends on ESPKIT_CAMERA_PRESET_CUSTOM
        default 8
        range 0 48
    config ESPKIT_CAMERA_PIN_D3
        int "Y5 / D3 GPIO"
        depends on ESPKIT_CAMERA_PRESET_CUSTOM
        default 10
        range 0 48
    config ESPKIT_CAMERA_PIN_D4
        int "Y6 / D4 GPIO"
        depends on ESPKIT_CAMERA_PRESET_CUSTOM
        default 12
        range 0 48
    config ESPKIT_CAMERA_PIN_D5
        int "Y7 / D5 GPIO"
        depends on ESPKIT_CAMERA_PRESET_CUSTOM
        default 18
        range 0 48
    config ESPKIT_CAMERA_PIN_D6
        int "Y8 / D6 GPIO"
        depends on ESPKIT_CAMERA_PRESET_CUSTOM
        default 17
        range 0 48
    config ESPKIT_CAMERA_PIN_D7
        int "Y9 / D7 GPIO"
        depends on ESPKIT_CAMERA_PRESET_CUSTOM
        default 16
        range 0 48
    config ESPKIT_CAMERA_PIN_VSYNC
        int "VSYNC GPIO"
        depends on ESPKIT_CAMERA_PRESET_CUSTOM
        default 6
        range 0 48
    config ESPKIT_CAMERA_PIN_HREF
        int "HREF GPIO"
        depends on ESPKIT_CAMERA_PRESET_CUSTOM
        default 7
        range 0 48
    config ESPKIT_CAMERA_PIN_PCLK
        int "PCLK GPIO"
        depends on ESPKIT_CAMERA_PRESET_CUSTOM
        default 13
        range 0 48

    choice ESPKIT_CAMERA_FRAME_SIZE
        prompt "JPEG frame size"
        default ESPKIT_CAMERA_FRAMESIZE_QVGA
        config ESPKIT_CAMERA_FRAMESIZE_QVGA
            bool "QVGA (320x240)"
        config ESPKIT_CAMERA_FRAMESIZE_VGA
            bool "VGA (640x480)"
    endchoice

    config ESPKIT_CAMERA_FRAME_COUNT
        int "Frames to capture after init"
        default 10
        range 1 60

endmenu
```
