## examples/ota-update/main/Kconfig.projbuild
```kconfig
menu "ESPKit OTA update"

    config ESPKIT_OTA_UPDATE_SSID
        string "Wi-Fi SSID"
        default ""
        help
            Leave empty in the committed defaults. Put the SSID in an untracked
            sdkconfig.defaults.local or sdkconfig.local, or provision it into
            the espkit NVS namespace.

    config ESPKIT_OTA_UPDATE_PASSWORD
        string "Wi-Fi password"
        default ""
        help
            WPA2-PSK password. Never commit this value. It is not logged.

    config ESPKIT_OTA_UPDATE_LED_GPIO
        int "Onboard WS2812 GPIO"
        default 48
        range 0 48
        help
            Data pin for the onboard WS2812 RGB LED. GPIO 48 is the usual pin
            on ESP32-S3-WROOM CAM / Freenove-style boards.

    config ESPKIT_OTA_UPDATE_LED_COUNT
        int "WS2812 LED count"
        default 1
        range 1 16

    config ESPKIT_OTA_UPDATE_ALLOW_HTTP
        bool "Allow plaintext HTTP firmware pull (LAN testing only)"
        default n
        select ESP_HTTPS_OTA_ALLOW_HTTP
        help
            HTTPS pulls are the default. Enable this only on a trusted LAN
            when you need to pull an image from an http:// URL. Uploading a
            file to POST /update does not use this option.

    config ESPKIT_OTA_UPDATE_FAIL_SELF_CHECK
        bool "Fail the post-boot self-check (rollback test image)"
        default n
        help
            For a rollback test, build one image with this option enabled,
            update to it, and confirm the board reverts to the previous slot
            after the grace period. Leave it off for normal images.

    config ESPKIT_OTA_UPDATE_REFUSE_GRACE_S
        int "Seconds to keep a refused image reachable before rollback"
        default 8
        range 0 30
        help
            After a failed self-check the HTTP status page stays up this long
            so you can see the new version before the board reboots into the
            previous slot.

endmenu
```

## examples/ota-update/sdkconfig.defaults
```kconfig
CONFIG_COMPILER_CXX_EXCEPTIONS=n
CONFIG_COMPILER_CXX_RTTI=n
CONFIG_ESPTOOLPY_FLASHSIZE_16MB=y
CONFIG_ESPKIT_NETWORK_ENABLED=y
CONFIG_PARTITION_TABLE_CUSTOM=y
CONFIG_PARTITION_TABLE_CUSTOM_FILENAME="../../partitions.csv"
CONFIG_BOOTLOADER_APP_ROLLBACK_ENABLE=y
CONFIG_ESP_CONSOLE_UART_DEFAULT=y
CONFIG_ESP_CONSOLE_SECONDARY_USB_SERIAL_JTAG=y
CONFIG_ESP_MAIN_TASK_STACK_SIZE=8192
```

## examples/wifi-check/main/Kconfig.projbuild
```kconfig
menu "ESPKit Wi-Fi check"

    config ESPKIT_WIFI_CHECK_SSID
        string "Wi-Fi SSID"
        default ""
        help
            Leave empty in the committed defaults. Put the SSID in an untracked
            sdkconfig.defaults.local or sdkconfig.local (see the example README)
            or provision it into the espkit NVS namespace.

    config ESPKIT_WIFI_CHECK_PASSWORD
        string "Wi-Fi password"
        default ""
        help
            WPA2-PSK password. Never commit this value. It is not logged.

    config ESPKIT_WIFI_CHECK_SAVE_TO_NVS
        bool "Save Kconfig credentials into the espkit NVS namespace after a successful connect"
        default n
        help
            Writes only wifi_ssid and wifi_pass. Schema, MQTT, and identity
            keys are left unchanged. Off by default so CI and first flashes
            do not write flash.

    config ESPKIT_WIFI_CHECK_SNTP
        bool "Synchronize time with SNTP after the station is up"
        default y

endmenu
```

## examples/wifi-check/sdkconfig.defaults
```kconfig
CONFIG_COMPILER_CXX_EXCEPTIONS=n
CONFIG_COMPILER_CXX_RTTI=n
CONFIG_ESPTOOLPY_FLASHSIZE_16MB=y
CONFIG_ESPKIT_NETWORK_ENABLED=y
```
